## buildroot-external-mender/board/freescale/imx8mqevk/mender_freescale_imx8mqevk_defconfig
```kconfig
# Configration fragment from buildroot-external-mender/board/freescale/imx8mqevk

BR2_GLOBAL_PATCH_DIR="$(BR2_EXTERNAL_MENDER_PATH)/board/common/patches/ $(BR2_EXTERNAL_MENDER_PATH)/board/freescale/imx8mqevk/patches/"
BR2_ROOTFS_OVERLAY="$(BR2_EXTERNAL_MENDER_PATH)/board/common/rootfs_overlay $(BR2_EXTERNAL_MENDER_PATH)/board/freescale/imx8mqevk/rootfs_overlay"
BR2_ROOTFS_POST_IMAGE_SCRIPT="board/freescale/common/imx/imx8-bootloader-prepare.sh $(BR2_EXTERNAL_MENDER_PATH)/board/freescale/imx8mqevk/post-image.sh"
```

## buildroot-external-mender/configs/beaglebone_mender_defconfig
```kconfig
BR2_arm=y
BR2_cortex_a8=y
BR2_DL_DIR="$(TOPDIR)/buildroot-external-mender/dl"
BR2_CCACHE=y
BR2_CCACHE_DIR="/home/ccache/beaglebone"
BR2_CCACHE_INITIAL_SETUP="--max-size=5G"
BR2_TIME_BITS_64=y
BR2_PER_PACKAGE_DIRECTORIES=y
BR2_TOOLCHAIN_EXTERNAL=y
BR2_TOOLCHAIN_EXTERNAL_BOOTLIN=y
BR2_TOOLCHAIN_EXTERNAL_BOOTLIN_ARMV7_EABIHF_GLIBC_STABLE=y
BR2_INIT_SYSTEMD=y
BR2_SYSTEM_BIN_SH_BASH=y
BR2_TARGET_GENERIC_GETTY_PORT="ttyS0"
BR2_SYSTEM_DEFAULT_PATH="/bin:/sbin:/usr/bin:/usr/sbin"
BR2_ROOTFS_OVERLAY="buildroot-external-mender/board/beaglebone/overlay"
BR2_ROOTFS_POST_BUILD_SCRIPT="buildroot-external-mender/board/beaglebone/post-build.sh"
BR2_ROOTFS_POST_IMAGE_SCRIPT="buildroot-external-mender/board/beaglebone/post-image.sh"
BR2_ROOTFS_POST_SCRIPT_ARGS="--artifact-name=2025.02.04 --data-part-size=128M --generate-mender-image=true --device-type=beaglebone"
BR2_LINUX_KERNEL=y
BR2_LINUX_KERNEL_CUSTOM_TARBALL=y
BR2_LINUX_KERNEL_CUSTOM_TARBALL_LOCATION="$(call github,beagleboard,linux,6.12.34-ti-arm32-r12)/linux-6.12.34-ti-arm32-r12.tar.gz"
BR2_LINUX_KERNEL_DEFCONFIG="omap2plus"
BR2_LINUX_KERNEL_CONFIG_FRAGMENT_FILES="buildroot-external-mender/configs/fragments/linux/beaglebone.fragment"
BR2_LINUX_KERNEL_DTS_SUPPORT=y
BR2_LINUX_KERNEL_INTREE_DTS_NAME="ti/omap/am335x-evm ti/omap/am335x-bone ti/omap/am335x-boneblack ti/omap/am335x-bonegreen ti/omap/am335x-evmsk ti/omap/am335x-boneblue ti/omap/am335x-boneblack-wireless ti/omap/am335x-bonegreen-wireless"
BR2_LINUX_KERNEL_INSTALL_TARGET=y
BR2_LINUX_KERNEL_NEEDS_HOST_OPENSSL=y
BR2_LINUX_KERNEL_NEEDS_HOST_LIBELF=y
BR2_PACKAGE_XZ=y
BR2_PACKAGE_ZSTD=y
BR2_PACKAGE_E2FSPROGS=y
BR2_PACKAGE_E2FSPROGS_RESIZE2FS=y
BR2_PACKAGE_PARTED=y
BR2_PACKAGE_UBOOT_TOOLS=y
BR2_PACKAGE_LIBGLIB2=y
BR2_PACKAGE_MENDER=y
BR2_PACKAGE_MENDER_IDENTITY_SCRIPTS=y
BR2_PACKAGE_MENDER_INVENTORY_SCRIPTS=y
BR2_PACKAGE_MENDER_INVENTORY_NETWORK_SCRIPTS=y
BR2_PACKAGE_MENDER_MODULES=y
BR2_PACKAGE_MENDER_MODULES_GEN=y
BR2_PACKAGE_MENDER_AUTH=y
BR2_PACKAGE_MENDER_CONNECT=y
BR2_TARGET_ROOTFS_EXT2=y
BR2_TARGET_ROOTFS_EXT2_4=y
BR2_TARGET_ROOTFS_EXT2_SIZE="256M"
BR2_TARGET_UBOOT=y
BR2_TARGET_UBOOT_BUILD_SYSTEM_KCONFIG=y
BR2_TARGET_UBOOT_CUSTOM_VERSION=y
BR2_TARGET_UBOOT_CUSTOM_VERSION_VALUE="2025.07"
BR2_TARGET_UBOOT_BOARD_DEFCONFIG="am335x_evm"
BR2_TARGET_UBOOT_CONFIG_FRAGMENT_FILES="buildroot-external-mender/configs/fragments/uboot/beaglebone.fragment"
BR2_TARGET_UBOOT_PATCH="buildroot-external-mender/patches/uboot"
BR2_TARGET_UBOOT_NEEDS_DTC=y
BR2_TARGET_UBOOT_NEEDS_GNUTLS=y
BR2_TARGET_UBOOT_NEEDS_OPENSSL=y
# BR2_TARGET_UBOOT_FORMAT_BIN is not set
BR2_TARGET_UBOOT_FORMAT_IMG=y
BR2_TARGET_UBOOT_SPL=y
BR2_TARGET_UBOOT_SPL_NAME="MLO"
BR2_PACKAGE_HOST_DOSFSTOOLS=y
BR2_PACKAGE_HOST_GENIMAGE=y
BR2_PACKAGE_HOST_MENDER_ARTIFACT=y
BR2_PACKAGE_HOST_MTOOLS=y
BR2_PACKAGE_HOST_UBOOT_TOOLS=y
BR2_PACKAGE_HOST_UBOOT_TOOLS_FIT_SUPPORT=y
BR2_PACKAGE_HOST_ZSTD=y
```

## buildroot-external-mender/configs/freescale_imx8mqevk_mender_defconfig
```kconfig
BR2_aarch64=y
BR2_ARM_FPU_VFPV3=y
BR2_TOOLCHAIN_EXTERNAL=y
BR2_TOOLCHAIN_EXTERNAL_BOOTLIN=y
BR2_TOOLCHAIN_EXTERNAL_BOOTLIN_AARCH64_GLIBC_STABLE=y
BR2_DL_DIR="$(TOPDIR)/buildroot-external-mender/dl"
BR2_GLOBAL_PATCH_DIR="buildroot-external-mender/patches/packages"
BR2_CCACHE=y
BR2_CCACHE_DIR="/home/ccache/imx8mqevk"
BR2_CCACHE_INITIAL_SETUP="--max-size=5G"
BR2_PER_PACKAGE_DIRECTORIES=y
BR2_INIT_SYSTEMD=y
BR2_SYSTEM_BIN_SH_BASH=y
BR2_TARGET_GENERIC_GETTY_PORT="ttymxc0"
BR2_SYSTEM_DEFAULT_PATH="/bin:/sbin:/usr/bin:/usr/sbin"
BR2_ROOTFS_OVERLAY="buildroot-external-mender/board/common/overlay buildroot-external-mender/board/freescale/imx8mqevk/overlay"
BR2_ROOTFS_POST_BUILD_SCRIPT="buildroot-external-mender/board/freescale/imx8mqevk/post-build.sh"
BR2_ROOTFS_POST_IMAGE_SCRIPT="board/freescale/common/imx/imx8-bootloader-prepare.sh buildroot-external-mender/board/freescale/imx8mqevk/post-image.sh"
BR2_ROOTFS_POST_SCRIPT_ARGS="${UBOOT_DIR}/arch/arm/dts/imx8mq-evk.dtb --artifact-name=2024.05-345-g39d23ce823-dirty --data-part-size=128M --generate-mender-image=true --device-type=imx8mqevk"
BR2_LINUX_KERNEL=y
BR2_LINUX_KERNEL_CUSTOM_TARBALL=y
BR2_LINUX_KERNEL_CUSTOM_TARBALL_LOCATION="$(call github,nxp-imx,linux-imx,lf-6.6.23-2.0.0)/linux-imx-lf-6.6.23-2.0.0.tar.gz"
BR2_LINUX_KERNEL_USE_ARCH_DEFAULT_CONFIG=y
BR2_LINUX_KERNEL_DTS_SUPPORT=y
BR2_LINUX_KERNEL_INTREE_DTS_NAME="freescale/imx8mq-evk"
BR2_LINUX_KERNEL_INSTALL_TARGET=y
BR2_LINUX_KERNEL_NEEDS_HOST_OPENSSL=y
BR2_LINUX_KERNEL_NEEDS_HOST_LIBELF=y
BR2_PACKAGE_XZ=y
BR2_PACKAGE_ZSTD=y
BR2_PACKAGE_E2FSPROGS=y
BR2_PACKAGE_FREESCALE_IMX=y
BR2_PACKAGE_FREESCALE_IMX_PLATFORM_IMX8M=y
BR2_PACKAGE_FIRMWARE_IMX=y
BR2_PACKAGE_CA_CERTIFICATES=y
BR2_PACKAGE_NTP=y
BR2_PACKAGE_NTP_SNTP=y
BR2_PACKAGE_MENDER=y
BR2_PACKAGE_MENDER_IDENTITY_SCRIPTS=y
BR2_PACKAGE_MENDER_INVENTORY_SCRIPTS=y
BR2_PACKAGE_MENDER_INVENTORY_NETWORK_SCRIPTS=y
BR2_PACKAGE_MENDER_MODULES=y
BR2_PACKAGE_MENDER_MODULES_GEN=y
BR2_PACKAGE_MENDER_AUTH=y
BR2_PACKAGE_MENDER_CONNECT=y
BR2_TARGET_ROOTFS_EXT2=y
BR2_TARGET_ROOTFS_EXT2_4=y
BR2_TARGET_ROOTFS_EXT2_SIZE="256M"
BR2_TARGET_ROOTFS_EXT2_MKFS_OPTIONS="-O 64bit"
BR2_TARGET_ARM_TRUSTED_FIRMWARE=y
BR2_TARGET_ARM_TRUSTED_FIRMWARE_CUSTOM_TARBALL=y
BR2_TARGET_ARM_TRUSTED_FIRMWARE_CUSTOM_TARBALL_LOCATION="$(call github,nxp-imx,imx-atf,lf-6.1.55-2.2.0)/imx-atf-lf-6.1.55-2.2.0.tar.gz"
BR2_TARGET_ARM_TRUSTED_FIRMWARE_PLATFORM="imx8mq"
BR2_TARGET_ARM_TRUSTED_FIRMWARE_BL31=y
BR2_TARGET_UBOOT=y
BR2_TARGET_UBOOT_BUILD_SYSTEM_KCONFIG=y
BR2_TARGET_UBOOT_CUSTOM_TARBALL=y
BR2_TARGET_UBOOT_CUSTOM_TARBALL_LOCATION="$(call github,nxp-imx,uboot-imx,lf-6.1.55-2.2.0)/uboot-imx-lf-6.1.55-2.2.0.tar.gz"
BR2_TARGET_UBOOT_PATCH="buildroot-external-mender/patches/uboot"
BR2_TARGET_UBOOT_BOARD_DEFCONFIG="imx8mq_evk"
BR2_TARGET_UBOOT_CONFIG_FRAGMENT_FILES="buildroot-external-mender/configs/fragments/uboot/imx8mqevk.fragment"
BR2_TARGET_UBOOT_NEEDS_DTC=y
BR2_TARGET_UBOOT_NEEDS_PYLIBFDT=y
BR2_TARGET_UBOOT_NEEDS_OPENSSL=y
BR2_TARGET_UBOOT_NEEDS_GNUTLS=y
BR2_TARGET_UBOOT_NEEDS_UTIL_LINUX=y
BR2_TARGET_UBOOT_FORMAT_CUSTOM=y
BR2_TARGET_UBOOT_FORMAT_CUSTOM_NAME="u-boot-nodtb.bin"
BR2_TARGET_UBOOT_SPL=y
BR2_PACKAGE_HOST_DOSFSTOOLS=y
BR2_PACKAGE_HOST_GENEXT2FS=y
BR2_PACKAGE_HOST_GENIMAGE=y
BR2_PACKAGE_HOST_IMX_MKIMAGE=y
BR2_PACKAGE_HOST_MENDER_ARTIFACT=y
BR2_PACKAGE_HOST_MTOOLS=y
BR2_PACKAGE_HOST_UBOOT_TOOLS=y
BR2_PACKAGE_HOST_UBOOT_TOOLS_FIT_SUPPORT=y
BR2_PACKAGE_HOST_ZSTD=y
```

## buildroot-external-mender/configs/x86_64_mender_defconfig
```kconfig
BR2_x86_64=y
BR2_TOOLCHAIN_EXTERNAL=y
BR2_TOOLCHAIN_EXTERNAL_BOOTLIN_X86_64_GLIBC_STABLE=y
BR2_DL_DIR="buildroot-external-mender/dl"
BR2_CCACHE=y
BR2_CCACHE_DIR="/home/ccache/x86_64"
BR2_CCACHE_INITIAL_SETUP="--max-size=5G"
BR2_PER_PACKAGE_DIRECTORIES=y
BR2_INIT_SYSTEMD=y
BR2_SYSTEM_BIN_SH_BASH=y
BR2_TARGET_GENERIC_GETTY_PORT="ttyS0"
BR2_SYSTEM_DEFAULT_PATH="/bin:/sbin:/usr/bin:/usr/sbin"
BR2_ROOTFS_OVERLAY="buildroot-external-mender/board/x86_64/overlay"
BR2_ROOTFS_POST_BUILD_SCRIPT="buildroot-external-mender/board/x86_64/post-build.sh"
BR2_ROOTFS_POST_IMAGE_SCRIPT="buildroot-external-mender/board/x86_64/post-image.sh"
BR2_ROOTFS_POST_SCRIPT_ARGS="--artifact-name=2024.08 --data-part-size=128M --generate-mender-image=true --device-type=x64"
BR2_LINUX_KERNEL=y
BR2_LINUX_KERNEL_CUSTOM_VERSION=y
BR2_LINUX_KERNEL_CUSTOM_VERSION_VALUE="6.6.61"
BR2_LINUX_KERNEL_USE_CUSTOM_CONFIG=y
BR2_LINUX_KERNEL_CUSTOM_CONFIG_FILE="buildroot-external-mender/board/x86_64/linux.config"
BR2_LINUX_KERNEL_INSTALL_TARGET=y
BR2_LINUX_KERNEL_NEEDS_HOST_OPENSSL=y
BR2_LINUX_KERNEL_NEEDS_HOST_LIBELF=y
BR2_PACKAGE_XZ=y
BR2_PACKAGE_ZSTD=y
BR2_PACKAGE_E2FSPROGS=y
BR2_PACKAGE_LINUX_FIRMWARE=y
BR2_PACKAGE_LINUX_FIRMWARE_ATHEROS_9170=y
BR2_PACKAGE_LINUX_FIRMWARE_ATHEROS_9271=y
BR2_PACKAGE_LINUX_FIRMWARE_IWLWIFI_3160=y
BR2_PACKAGE_LINUX_FIRMWARE_IWLWIFI_3168=y
BR2_PACKAGE_LINUX_FIRMWARE_IWLWIFI_5000=y
BR2_PACKAGE_LINUX_FIRMWARE_IWLWIFI_6000G2A=y
BR2_PACKAGE_LINUX_FIRMWARE_IWLWIFI_6000G2B=y
BR2_PACKAGE_LINUX_FIRMWARE_IWLWIFI_7260=y
BR2_PACKAGE_LINUX_FIRMWARE_IWLWIFI_7265D=y
BR2_PACKAGE_LINUX_FIRMWARE_IWLWIFI_8000C=y
BR2_PACKAGE_LINUX_FIRMWARE_IWLWIFI_8265=y
BR2_PACKAGE_LINUX_FIRMWARE_RALINK_RT73=y
BR2_PACKAGE_LINUX_FIRMWARE_RALINK_RT2XX=y
BR2_PACKAGE_LINUX_FIRMWARE_RTL_81XX=y
BR2_PACKAGE_LINUX_FIRMWARE_RTL_87XX=y
BR2_PACKAGE_LINUX_FIRMWARE_RTL_88XX=y
BR2_PACKAGE_LINUX_FIRMWARE_RTL_8169=y
BR2_PACKAGE_ACPID=y
BR2_PACKAGE_CONNMAN=y
BR2_PACKAGE_CONNMAN_WIFI=y
BR2_PACKAGE_CONNMAN_CLIENT=y
BR2_PACKAGE_OPENSSH=y
BR2_PACKAGE_MENDER=y
BR2_PACKAGE_MENDER_AUTHD=y
BR2_PACKAGE_MENDER_CONNECT=y
BR2_PACKAGE_MENDER_GRUBENV=y
BR2_PACKAGE_MENDER_GRUBENV_DEFINES="buildroot-external-mender/board/x86_64/mender_grubenv_defines"
BR2_TARGET_ROOTFS_EXT2=y
BR2_TARGET_ROOTFS_EXT2_4=y
BR2_TARGET_ROOTFS_EXT2_SIZE="256M"
BR2_TARGET_ROOTFS_EXT2_MKFS_OPTIONS="-O 64bit"
# BR2_TARGET_ROOTFS_TAR is not set
BR2_TARGET_GRUB2=y
BR2_TARGET_GRUB2_X86_64_EFI=y
BR2_TARGET_GRUB2_BUILTIN_MODULES_EFI="boot linux ext2 fat squash4 part_msdos part_gpt normal efi_gop loadenv hashsum echo halt gcry_sha256 test regexp"
BR2_TARGET_GRUB2_INSTALL_TOOLS=y
BR2_PACKAGE_HOST_DOSFSTOOLS=y
BR2_PACKAGE_HOST_GENIMAGE=y
BR2_PACKAGE_HOST_MENDER_ARTIFACT=y
BR2_PACKAGE_HOST_MTOOLS=y
BR2_PACKAGE_HOST_ZSTD=y
```

## buildroot-external-mender/package/lmdb/Config.in
```kconfig
config BR2_PACKAGE_LMDB
	bool "lmdb"
	help
	  LMDB is an ultra-fast, ultra-compact key-value embedded data
	  store developed by Symas for the OpenLDAP Project. By using
	  memory-mapped files, it provides the read performance of a
	  pure in-memory database while still offering the persistence
	  of standard disk-based databases, and is only limited to the
	  size of the virtual address space.
```

## buildroot-external-mender/package/mender-app-update-module/Config.in
```kconfig
config BR2_PACKAGE_MENDER_APP_UPDATE_MODULE
	bool "mender-app-update-module"
	depends on BR2_PACKAGE_HOST_GO_TARGET_ARCH_SUPPORTS
	depends on BR2_PACKAGE_HOST_GO_TARGET_CGO_LINKING_SUPPORTS
	depends on BR2_TOOLCHAIN_HAS_THREADS
	select BR2_PACKAGE_MENDER
	help
	  Mender Application Update Module with related tools for
	  supporting containerized application updates on devices.

	  https://github.com/mendersoftware/app-update-module

comment "mender-app-update-module needs a toolchain w/ threads"
	depends on BR2_PACKAGE_HOST_GO_TARGET_ARCH_SUPPORTS
	depends on BR2_PACKAGE_HOST_GO_TARGET_CGO_LINKING_SUPPORTS
	depends on !BR2_TOOLCHAIN_HAS_THREADS
```

## buildroot-external-mender/package/mender-configure-module/Config.in
```kconfig
config BR2_PACKAGE_MENDER_CONFIGURE_MODULE
	bool "mender-configure-module"
	depends on BR2_PACKAGE_HOST_GO_TARGET_ARCH_SUPPORTS
	depends on BR2_PACKAGE_HOST_GO_TARGET_CGO_LINKING_SUPPORTS
	depends on BR2_TOOLCHAIN_HAS_THREADS
	select BR2_PACKAGE_MENDER
	help
	  update module for applying configuration to a device. The
	  mender-configure module accepts artifacts of mender-configure
	  type. On each configuration update, mender-configure module
	  executes all the scripts from the scripts directory
	  (defaults to /usr/lib/mender-configure/apply-device-config.d).
	  The update module executes each script with a path to the
	  configuration file passed as an argument and checks the exit
	  code of the script. Return code 20 is interpreted as
	  success-but-reboot-needed. The module also supports rollback.

	  https://github.com/mendersoftware/mender-configure-module

if BR2_PACKAGE_MENDER_CONFIGURE_MODULE

config BR2_PACKAGE_MENDER_CONFIGURE_MODULE_RASPBERRY_PI_LED_DEMO
	bool "install raspberry-pi LED demo"
	help
	  Script which configures the led of the Raspberry Pi device,
	  according to the mender-demo-raspberrypi-led" key, given in
	  the file in the first argument.

endif

comment "mender-configure-module needs a toolchain w/ threads"
	depends on BR2_PACKAGE_HOST_GO_TARGET_ARCH_SUPPORTS
	depends on BR2_PACKAGE_HOST_GO_TARGET_CGO_LINKING_SUPPORTS
	depends on !BR2_TOOLCHAIN_HAS_THREADS
```

## buildroot-external-mender/package/mender-flash/Config.in
```kconfig
config BR2_PACKAGE_MENDER_FLASH
	bool "mender-flash"
	depends on BR2_PACKAGE_HOST_GO_TARGET_ARCH_SUPPORTS
	depends on BR2_PACKAGE_HOST_GO_TARGET_CGO_LINKING_SUPPORTS
	depends on BR2_TOOLCHAIN_HAS_THREADS
	select BR2_PACKAGE_MENDER
	help
	  Utility to flash block devices.

	  https://github.com/mendersoftware/mender-flash

comment "mender-flash needs a toolchain w/ threads"
	depends on BR2_PACKAGE_HOST_GO_TARGET_ARCH_SUPPORTS
	depends on BR2_PACKAGE_HOST_GO_TARGET_CGO_LINKING_SUPPORTS
	depends on !BR2_TOOLCHAIN_HAS_THREADS
```

## buildroot-external-mender/package/mender-snapshot/Config.in
```kconfig
config BR2_PACKAGE_MENDER_SNAPSHOT
	bool "mender-snapshot"
	depends on BR2_PACKAGE_HOST_GO_TARGET_ARCH_SUPPORTS
	depends on BR2_PACKAGE_HOST_GO_TARGET_CGO_LINKING_SUPPORTS
	help
	  A tool create a snapshot of the current running rootfs
	  partition. It is used by the mender-artifact tool to generate
	  a "golden image" Artifact based on the current rootfs
	  partition of a given device.

	  https://github.com/mendersoftware/mender-snapshot
```
